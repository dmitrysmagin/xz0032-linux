## arch/mips/jz47xx/Kconfig
```kconfig
choice
	prompt "SoC type"
	depends on MACH_JZ47XX
	default MACH_JZ4740

config MACH_JZ4740
	bool "JZ4740"
	select JZ47XX_TIMER_CSRC
	select JZ47XX_TIMER_CEVT
	select JZ47XX_GPIOV2

config MACH_JZ4750L
	bool "JZ4750L"
	select JZ47XX_OST
	select JZ47XX_GPIOV2

config MACH_JZ4760
	bool "JZ4760"
	select JZ47XX_OST
	select JZ47XX_GPIOV2

endchoice

source "arch/mips/jz47xx/jz4740/Kconfig"
source "arch/mips/jz47xx/jz4750/Kconfig"
source "arch/mips/jz47xx/jz4760/Kconfig"

config HAVE_PWM
	bool

config JZ47XX_TIMER_CSRC
	bool

config JZ47XX_TIMER_CEVT
	bool

config JZ47XX_OST
	bool

config JZ47XX_GPIOV2
	bool
```

## arch/mips/jz47xx/jz4750/Kconfig
```kconfig
if MACH_JZ4750L

choice
	prompt "Machine type"
	depends on MACH_JZ4750L
	default JZ4750L_XZ0032

config JZ4750L_XZ0032
	bool "XZ0032 board"

endchoice

config JZ4750L_XZ0032_I2C_PINS_AS_KEYS
	bool "Use I2C pins for GPIO keys"
	depends on JZ4750L_XZ0032
	help
	  XZ0032 board has I2C controller pins attached to unsoldered pads. They
	  can alternatively be configured as GPIO and used to connect two
	  additional keys.

config JZ4750L_XZ0032_UART0_RX_PIN_AS_KEY
	bool "Use UART0 RX pin for a GPIO key"
	depends on JZ4750L_XZ0032
	help
	  XZ0032 board has UART0 RX pin attached to unsoldered pad. It can
	  alternatively be configured as GPIO and used to connect an additional key.

endif
```

## arch/mips/jz47xx/jz4760/Kconfig
```kconfig
choice
	prompt "Machine type"
	depends on MACH_JZ4760
	default JZ4760_LEPUS

config JZ4760_LEPUS
	bool "Ingenic JZ4760 Lepus devboard"

endchoice
```
